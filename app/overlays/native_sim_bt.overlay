/*
 * Copyright (c) 2026 Muhammad Waleed Badar
 * SPDX-License-Identifier: GPL-3.0-only
 *
 * The Linux host's Bluetooth adapter as the controller of native_sim
 * (HCI user channel); goes with overlays/native_sim_bt.conf.
 */
&bt_hci_userchan {
	status = "okay";
};
