/*
 * Copyright (c) 2026 Muhammad Waleed Badar
 * SPDX-License-Identifier: GPL-3.0-only
 *
 * A small portrait display for native_sim:
 *   west build ... -- -DEXTRA_DTC_OVERLAY_FILE=overlays/native_sim_240x320.overlay
 */
&sdl_dc {
	width = <240>;
	height = <320>;
};
