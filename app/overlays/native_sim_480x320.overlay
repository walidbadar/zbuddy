/*
 * Copyright (c) 2026 Muhammad Waleed Badar
 * SPDX-License-Identifier: GPL-3.0-only
 *
 * A landscape display for native_sim:
 *   west build ... -- -DEXTRA_DTC_OVERLAY_FILE=overlays/native_sim_480x320.overlay
 */
&sdl_dc {
	width = <480>;
	height = <320>;
};
