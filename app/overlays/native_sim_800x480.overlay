/*
 * Copyright (c) 2026 Muhammad Waleed Badar
 * SPDX-License-Identifier: GPL-3.0-only
 *
 * A large landscape display for native_sim:
 *   west build ... -- -DEXTRA_DTC_OVERLAY_FILE=overlays/native_sim_800x480.overlay
 */
&sdl_dc {
	width = <800>;
	height = <480>;
};
